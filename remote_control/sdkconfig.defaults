## remote_control/sdkconfig.defaults
```kconfig
# remote_control defaults — classic ESP32 handheld
CONFIG_IDF_TARGET="esp32"

# Flash (4MB typical devkit)
CONFIG_ESPTOOLPY_FLASHSIZE_4MB=y
CONFIG_ESPTOOLPY_FLASHMODE_QIO=y

# Partition table: OTA-capable
CONFIG_PARTITION_TABLE_CUSTOM=y
CONFIG_PARTITION_TABLE_CUSTOM_FILENAME="partitions.csv"
CONFIG_PARTITION_TABLE_FILENAME="partitions.csv"

# FreeRTOS robustness
CONFIG_ESP_TASK_WDT_EN=y
CONFIG_ESP_TASK_WDT_PANIC=y
CONFIG_ESP_TASK_WDT_TIMEOUT_S=10
CONFIG_ESP_INT_WDT=y

# Logging
CONFIG_LOG_DEFAULT_LEVEL_INFO=y

# WiFi (STA for startup OTA check; ESP-NOW LR coexists)
CONFIG_ESP_WIFI_NVS_ENABLED=y
CONFIG_ESP_WIFI_SOFTAP_SUPPORT=n

# LVGL / display
CONFIG_LV_COLOR_DEPTH_16=y
CONFIG_LV_FONT_MONTSERRAT_14=y
CONFIG_LV_FONT_MONTSERRAT_20=y
CONFIG_LV_FONT_MONTSERRAT_28=y
CONFIG_LV_USE_LABEL=y
CONFIG_LV_USE_BUTTON=y
CONFIG_LV_USE_BAR=y
CONFIG_LV_USE_ARC=y

# Main task
CONFIG_ESP_MAIN_TASK_STACK_SIZE=6144
```

## vfd_controller/sdkconfig.defaults
```kconfig
# vfd_controller defaults — ESP32-S3
CONFIG_IDF_TARGET="esp32s3"

# Flash / PSRAM (S3 module with 8MB flash, 8MB PSRAM typical)
CONFIG_ESPTOOLPY_FLASHSIZE_8MB=y
CONFIG_ESPTOOLPY_FLASHMODE_QIO=y
CONFIG_SPIRAM=y
CONFIG_SPIRAM_MODE_OCT=y
CONFIG_SPIRAM_SPEED_80M=y

# Partition table: OTA-capable (2 app slots + NVS + log storage)
CONFIG_PARTITION_TABLE_CUSTOM=y
CONFIG_PARTITION_TABLE_CUSTOM_FILENAME="partitions.csv"
CONFIG_PARTITION_TABLE_FILENAME="partitions.csv"

# FreeRTOS robustness
CONFIG_FREERTOS_USE_TASK_WDT=y
CONFIG_FREERTOS_TASK_WDT_PANIC=y
CONFIG_FREERTOS_INTERRUPT_BACKTRACE=y
CONFIG_ESP_TASK_WDT_EN=y
CONFIG_ESP_TASK_WDT_TIMEOUT_S=10
CONFIG_ESP_INT_WDT=y

# Logging
CONFIG_LOG_DEFAULT_LEVEL_INFO=y
CONFIG_LOG_MAXIMUM_LEVEL_DEBUG=y

# HTTP server (dashboard)
CONFIG_HTTPD_WS_SUPPORT=y
CONFIG_HTTPD_MAX_REQ_HDR_LEN=1024
CONFIG_HTTPD_MAX_URI_LEN=1024

# WiFi
CONFIG_ESP_WIFI_SOFTAP_SUPPORT=y
CONFIG_ESP_WIFI_NVS_ENABLED=y

# LWIP
CONFIG_LWIP_MAX_SOCKETS=16

# App version for OTA
CONFIG_APP_PROJECT_VER_FROM_CONFIG=y
CONFIG_APP_PROJECT_VER="0.1.0"

# Main task
CONFIG_ESP_MAIN_TASK_STACK_SIZE=6144
```
